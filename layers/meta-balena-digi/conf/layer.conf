## layers/meta-balena-digi/conf/layer.conf
```bitbake
BBPATH .= ":${LAYERDIR}"

BBFILES += "${LAYERDIR}/recipes-*/*/*.bb \
            ${LAYERDIR}/recipes-*/*/*.bbappend"

BBFILE_COLLECTIONS += "balena-digi"
BBFILE_PATTERN_balena-digi := "^${LAYERDIR}/"
BBFILE_PRIORITY_balena-digi = "1337"

LAYERSERIES_COMPAT_balena-digi = "warrior"
```
